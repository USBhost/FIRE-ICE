## drivers/input/touchscreen/synaptics_dsx/Kconfig
```kconfig
#
# Synaptics DSX touchscreen driver configuration
#
menuconfig TOUCHSCREEN_SYNAPTICS_DSX
	bool "Synaptics DSX touchscreen"
	default y
	help
	  Say Y here if you have a Synaptics DSX touchscreen connected
	  to your system.

	  If unsure, say N.

if TOUCHSCREEN_SYNAPTICS_DSX

choice
	default TOUCHSCREEN_SYNAPTICS_DSX_I2C
	prompt "Synaptics DSX bus interface"
config TOUCHSCREEN_SYNAPTICS_DSX_I2C
	bool "RMI over I2C"
	depends on I2C
config TOUCHSCREEN_SYNAPTICS_DSX_SPI
	bool "RMI over SPI"
	depends on SPI_MASTER
config TOUCHSCREEN_SYNAPTICS_DSX_RMI_HID_I2C
	bool "HID over I2C"
	depends on I2C
endchoice

config TOUCHSCREEN_SYNAPTICS_DSX_CORE
	tristate "Synaptics DSX core driver module"
	depends on I2C || SPI_MASTER
	help
	  Say Y here to enable basic touch reporting functionalities.

	  If unsure, say N.

	  To compile this driver as a module, choose M here: the
	  module will be called synaptics_dsx_core.

config TOUCHSCREEN_SYNAPTICS_DSX_CORE_SYSFS
	bool "Synaptics DSX core driver sysfs attributes"
	depends on TOUCHSCREEN_SYNAPTICS_DSX_CORE
	help
	  Say Y here to enable basic extra touch reporting sysfs attributes
	  for debugging or development.  This does not affect the core
	  sysfs attributes supplied by the platform, or the interactive or
	  wake_gesture add on attributes.

	  If unsure, say N.

config TOUCHSCREEN_SYNAPTICS_DSX_CORE_INTERACTIVE_SYSFS
	bool "Synaptics DSX core driver interactive sysfs attributes"
	depends on TOUCHSCREEN_SYNAPTICS_DSX_CORE
	default y
	help
	  Say Y here to enable interactive sysfs which controls the
	  power consumption of the touch panel.  This has no effect on
	  any other core sysfs attribute.

	  If unsure, say Y.

config TOUCHSCREEN_SYNAPTICS_DSX_CORE_WAKE_GESTURE_SYSFS
	bool "Synaptics DSX core driver wake_gesture sysfs attributes"
	depends on TOUCHSCREEN_SYNAPTICS_DSX_CORE
	default y
	help
	  Say Y here to enable wake_gesture sysfs which controls
	  whether double-tap to wake works.  This has no effect on
	  any other core sysfs attribute.

	  If unsure, say Y.

config TOUCHSCREEN_SYNAPTICS_DSX_RMI_DEV
	tristate "Synaptics DSX RMI device module"
	depends on TOUCHSCREEN_SYNAPTICS_DSX_CORE
	help
	  Say Y here to enable support for direct RMI register access.

	  If unsure, say N.

	  To compile this driver as a module, choose M here: the
	  module will be called synaptics_dsx_rmi_dev.

config TOUCHSCREEN_SYNAPTICS_DSX_RMI_DEV_SYSFS
	bool "Synaptics DSX RMI device sysfs attributes"
	depends on TOUCHSCREEN_SYNAPTICS_DSX_RMI_DEV
	help
	  Say Y here to enable support for sysfs attributes for the
	  direct RMI register access driver interface.  This does not
	  affect the core or other touch subsystem attributes, only
	  the rmidev tree.

	  If unsure, say N.

config TOUCHSCREEN_SYNAPTICS_DSX_FW_UPDATE
	tristate "Synaptics DSX firmware update module"
	depends on TOUCHSCREEN_SYNAPTICS_DSX_CORE
	help
	  Say Y here to enable support for doing firmware update.

	  If unsure, say N.

	  To compile this driver as a module, choose M here: the
	  module will be called synaptics_dsx_fw_update.

config TOUCHSCREEN_SYNAPTICS_DSX_FW_UPDATE_SYSFS
	bool "Synaptics DSX firmware update sysfs attributes"
	depends on TOUCHSCREEN_SYNAPTICS_DSX_FW_UPDATE
	help
	  Say Y here to enable support for sysfs attributes for
	  performing firmware update in a development environment.
	  This does not affect the core or other subsystem attributes.

	  If unsure, say N.

config TOUCHSCREEN_SYNAPTICS_DSX_ACTIVE_PEN
	tristate "Synaptics DSX active pen module"
	depends on TOUCHSCREEN_SYNAPTICS_DSX_CORE
	help
	  Say Y here to enable support for active pen functionalities.

	  If unsure, say N.

	  To compile this driver as a module, choose M here: the
	  module will be called synaptics_dsx_active_pen.

config TOUCHSCREEN_SYNAPTICS_DSX_PROXIMITY
	tristate "Synaptics DSX proximity module"
	depends on TOUCHSCREEN_SYNAPTICS_DSX_CORE
	help
	  Say Y here to enable support for proximity functionalities.

	  If unsure, say N.

	  To compile this driver as a module, choose M here: the
	  module will be called synaptics_dsx_proximity.

config TOUCHSCREEN_SYNAPTICS_DSX_PROXIMITY_SYSFS
	tristate "Synaptics DSX proximity sysfs attributes"
	depends on TOUCHSCREEN_SYNAPTICS_PROXIMITY
	help
	  Say Y here to enable support for proximity sysfs
	  attribute functionalities.  This does not affect the
	  core or other touch subsystem attributes.

	  If unsure, say N.

config TOUCHSCREEN_SYNAPTICS_DSX_TEST_REPORTING
	tristate "Synaptics DSX test reporting module"
	depends on TOUCHSCREEN_SYNAPTICS_DSX_CORE
	help
	  Say Y here to enable support for retrieving production test reports.

	  If unsure, say N.

	  To compile this driver as a module, choose M here: the
	  module will be called synaptics_dsx_test_reporting.

config TOUCHSCREEN_SYNAPTICS_DSX_DEBUG
	tristate "Synaptics DSX debug module"
	depends on TOUCHSCREEN_SYNAPTICS_DSX_CORE
	help
	  Say Y here to enable support for firmware debug functionalities.

	  If unsure, say N.

	  To compile this driver as a module, choose M here: the
	  module will be called synaptics_dsx_debug.

config TOUCHSCREEN_SYNAPTICS_DSX_WAKEUP_GESTURE
	bool "Synaptics DSX wake up gesture"
	depends on TOUCHSCREEN_SYNAPTICS_DSX_CORE
	help
	  Say Y here to enable support for double tap gesture.

	  If unsure, say N.
endif
```
